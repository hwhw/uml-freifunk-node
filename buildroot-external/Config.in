## buildroot-external/Config.in
```kconfig
source "$BR2_EXTERNAL/package/batman-adv-legacy-versioned/Config.in"
source "$BR2_EXTERNAL/package/alfred-versioned/Config.in"
source "$BR2_EXTERNAL/package/batctl-legacy-versioned/Config.in"
source "$BR2_EXTERNAL/package/batman-adv-legacy/Config.in"
source "$BR2_EXTERNAL/package/batctl-legacy/Config.in"
source "$BR2_EXTERNAL/package/alfred/Config.in"
source "$BR2_EXTERNAL/package/fastd/Config.in"
source "$BR2_EXTERNAL/package/libuecc/Config.in"
source "$BR2_EXTERNAL/package/libsodium/Config.in"
```

## buildroot-external/package/alfred-versioned/Config.in
```kconfig
config BR2_PACKAGE_ALFRED_VERSIONED
	bool "alfred-versioned"
	select BR2_PACKAGE_LIBCAP
	help
	  Alfred is the Almighty Lightweight Fact Remote Exchange Daemon

	  http://www.open-mesh.org/projects/alfred
```

## buildroot-external/package/batman-adv-legacy-versioned/Config.in
```kconfig
config BR2_PACKAGE_BATMAN_ADV_LEGACY_VERSIONED
	bool "batman-adv-legacy-versioned"
	depends on BR2_LINUX_KERNEL
	help
      batman-adv compat 14, with a few extra patches on top of 2013.4

      this is a hacked version with versioned symbols
	  https://github.com/hwhw/batman-adv-legacy

if BR2_PACKAGE_BATMAN_ADV_LEGACY_VERSIONED

config BR2_PACKAGE_BATMAN_ADV_LEGACY_VERSIONED_DEBUG
        bool "build batman-adv-legacy-versioned with debug output/information"

config BR2_PACKAGE_BATMAN_ADV_LEGACY_VERSIONED_BLA
        bool "build batman-adv-legacy-versioned with bridge loop avoidance"

config BR2_PACKAGE_BATMAN_ADV_LEGACY_VERSIONED_DAT
        bool "build batman-adv-legacy-versioned with distributed ARP table"

config BR2_PACKAGE_BATMAN_ADV_LEGACY_VERSIONED_NC
        bool "build batman-adv-legacy-versioned with network coding"
endif

comment "batman-adv-legacy-versioned needs a kernel"
	depends on !BR2_LINUX_KERNEL
```
